## arch/Kconfig
```kconfig
config CREATE_ARCH_SYMLINK
	bool

config HAVE_ARCH_IOREMAP
	bool

config X86
	bool "x86 architecture"
	select CREATE_ARCH_SYMLINK
	select HAVE_PRIVATE_LIBGCC
	select USE_PRIVATE_LIBGCC
	select SUPPORT_OF_CONTROL
	select OF_CONTROL
	select DM
	select DM_PCI
	select PCI
	select TIMER
	select X86_TSC_TIMER
	imply BLK
	imply DM_ETH
	imply DM_GPIO
	imply DM_KEYBOARD
	imply DM_MMC
	imply DM_RTC
	imply DM_SERIAL
	imply DM_SCSI
	imply DM_SPI
	imply DM_SPI_FLASH
	imply DM_USB
	imply DM_VIDEO
	imply CMD_FPGA_LOADMK
	imply CMD_GETTIME
	imply CMD_IO
	imply CMD_IRQ
	imply CMD_PCI
	imply CMD_SF_TEST
	imply CMD_ZBOOT
	imply USB_HOST_ETHER
	imply USB_ETHER_ASIX
	imply USB_ETHER_SMSC95XX

config SYS_ARCH
	string
	help
	  This option should contain the architecture name to build the
	  appropriate arch/<CONFIG_SYS_ARCH> directory.
	  All the architectures should specify this option correctly.

config SYS_CPU
	string
	help
	  This option should contain the CPU name to build the correct
	  arch/<CONFIG_SYS_ARCH>/cpu/<CONFIG_SYS_CPU> directory.

	  This is optional.  For those targets without the CPU directory,
	  leave this option empty.

config SYS_SOC
	string
	help
	  This option should contain the SoC name to build the directory
	  arch/<CONFIG_SYS_ARCH>/cpu/<CONFIG_SYS_CPU>/<CONFIG_SYS_SOC>.

	  This is optional.  For those targets without the SoC directory,
	  leave this option empty.

config SYS_VENDOR
	string
	help
	  This option should contain the vendor name of the target board.
	  If it is set and
	  board/<CONFIG_SYS_VENDOR>/common/Makefile exists, the vendor common
	  directory is compiled.
	  If CONFIG_SYS_BOARD is also set, the sources under
	  board/<CONFIG_SYS_VENDOR>/<CONFIG_SYS_BOARD> directory are compiled.

	  This is optional.  For those targets without the vendor directory,
	  leave this option empty.

config SYS_BOARD
	string
	help
	  This option should contain the name of the target board.
	  If it is set, either board/<CONFIG_SYS_VENDOR>/<CONFIG_SYS_BOARD>
	  or board/<CONFIG_SYS_BOARD> directory is compiled depending on
	  whether CONFIG_SYS_VENDOR is set or not.

	  This is optional.  For those targets without the board directory,
	  leave this option empty.

config SYS_CONFIG_NAME
	string
	help
	  This option should contain the base name of board header file.
	  The header file include/configs/<CONFIG_SYS_CONFIG_NAME>.h
	  should be included from include/config.h.

source "arch/x86/Kconfig"
```

## arch/x86/cpu/broadwell-de/Kconfig
```kconfig
#
# Copyright (C) 2017, Vincenzo Bove <vincenzo.bove@prodrive-technologies.com>
#
# SPDX-License-Identifier:	GPL-2.0+
#

config INTEL_BROADWELL_DE
	bool
	select HAVE_FSP
	#select ARCH_MISC_INIT
	#select CPU_INTEL_TURBO_NOT_PACKAGE_SCOPED
	imply HAVE_INTEL_ME
	#imply ENABLE_MRC_CACHE
	imply AHCI_PCI
	imply ICH_SPI
	imply INTEL_ICH6_GPIO
	imply SCSI
	imply SPI_FLASH
	imply SYS_NS16550
	imply USB
	imply USB_EHCI_HCD
	imply USB_XHCI_HCD
	imply VIDEO_VESA

if INTEL_BROADWELL_DE

config FSP_ADDR
	hex
	default 0xffeb0000

config FSP_USE_UPD
	bool
	default y

config FSP_MEMORY_DOWN
	bool
	default y

config HAVE_SPD
	bool
	default y

config DCACHE_RAM_BASE
	default 0xfef00000

config DCACHE_RAM_SIZE
	default 0x4000

config CPU_SPECIFIC_OPTIONS
	def_bool y
	select SMM_TSEG
	select X86_RAMTEST

config SMM_TSEG_SIZE
	hex
	default 0x800000

config INTERNAL_UART
	bool
	default y

config MAX_CPUS
	int
	default 16

endif
```

## board/prodrive/Kconfig
```kconfig
#
# Copyright (C) 2017, WarOfDevil <warofdevil@linux.com>
#
# SPDX-License-Identifier:	GPL-2.0+

if VENDOR_PRODRIVE

choice
	prompt "Mainboard model"
	optional

config TARGET_POSEIDON
	bool "Poseidon"
	help
	  This target is for Prodrive Poseidon.
	  Embedded board hosting x86 Broadwell-DE Xeon processor.

endchoice

source "board/prodrive/poseidon/Kconfig"

endif
```

## board/prodrive/poseidon/Kconfig
```kconfig
#
# Copyright (C) 2017, Vincenzo Bove <vincenzo.bove@prodrive-technologies.com>
#
# SPDX-License-Identifier:	GPL-2.0+

if TARGET_POSEIDON

config SYS_BOARD
	default "poseidon"

config SYS_VENDOR
	default "prodrive"

config SYS_SOC
	default "broadwell-de"

config SYS_CONFIG_NAME
	default "poseidon"

config SYS_TEXT_BASE
	default 0xffdb0000

config BOARD_SPECIFIC_OPTIONS # dummy
	def_bool y
	select X86_RESET_VECTOR
	select INTEL_BROADWELL_DE
	select BOARD_ROMSIZE_KB_16384
	select SPI_FLASH_MACRONIX

config PCIE_ECAM_BASE
	default 0x80000000

config SYS_CAR_ADDR
	hex
	default 0xfef00000

config SYS_CAR_SIZE
	hex
	default 0x40000


endif
```

## configs/camelback_defconfig
```kconfig
CONFIG_X86=y
CONFIG_SYS_CONFIG_NAME="poseidon"
CONFIG_VENDOR_PRODRIVE=y
CONFIG_DEFAULT_DEVICE_TREE="poseidon"
CONFIG_TARGET_POSEIDON=y
#CONFIG_INTERNAL_UART=y
CONFIG_SMP=y
CONFIG_HAVE_VGA_BIOS=y
CONFIG_VGA_BIOS_ADDR=0xfffd0001
CONFIG_FRAMEBUFFER_SET_VESA_MODE=y
CONFIG_FRAMEBUFFER_VESA_MODE_11A=y
CONFIG_GENERATE_PIRQ_TABLE=y
CONFIG_GENERATE_MP_TABLE=y
CONFIG_GENERATE_ACPI_TABLE=y
#CONFIG_HAVE_ACPI_RESUME=y
CONFIG_SEABIOS=y
CONFIG_FIT=y
CONFIG_BOOTSTAGE=y
CONFIG_BOOTSTAGE_REPORT=y
#CONFIG_USE_BOOTARGS=y
#CONFIG_BOOTARGS="console=ttyS0,115200 root=/dev/sdb3 init=/sbin/init rootwait ro"
CONFIG_SYS_CONSOLE_INFO_QUIET=y
CONFIG_HUSH_PARSER=y
CONFIG_CMD_CPU=y
CONFIG_CMD_GPIO=y
CONFIG_CMD_PART=y
CONFIG_CMD_SF=y
CONFIG_CMD_SPI=y
CONFIG_CMD_USB=y
CONFIG_CMD_DHCP=y
CONFIG_CMD_PING=y
CONFIG_CMD_TIME=y
CONFIG_CMD_BOOTSTAGE=y
CONFIG_CMD_EXT2=y
CONFIG_CMD_EXT4=y
CONFIG_CMD_EXT4_WRITE=y
CONFIG_CMD_FAT=y
CONFIG_CMD_FS_GENERIC=y
CONFIG_REGMAP=y
CONFIG_SYSCON=y
CONFIG_CPU=y
CONFIG_USB_STORAGE=y
CONFIG_USB_KEYBOARD=y
CONFIG_CONSOLE_SCROLL_LINES=5
#CONFIG_CMD_IMLS=n
CONFIG_SYS_NS16550=y
CONFIG_CMD_TPM=y
CONFIG_CMD_TPM_TEST=y
CONFIG_SPI_FLASH=y
CONFIG_SPI_FLASH_GIGADEVICE=y
CONFIG_SPI_FLASH_MACRONIX=y
CONFIG_SPI_FLASH_WINBOND=y
CONFIG_DM_ETH=y
CONFIG_E1000=y
CONFIG_DM_PCI=y
CONFIG_DM_RTC=y
CONFIG_TIMER=y
CONFIG_TPM_TIS_LPC=y
CONFIG_USB=y
CONFIG_DM_USB=y
CONFIG_USB_XHCI_HCD=y
CONFIG_USB_UHCI_HCD=y
#CONFIG_DM_VIDEO=y
CONFIG_USE_PRIVATE_LIBGCC=y
CONFIG_TPM=y
CONFIG_OF_CONTROL=y
```
